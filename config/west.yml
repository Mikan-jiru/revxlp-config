## config/west.yml
```yaml
manifest:
  remotes:
    - name: mikan-jiru
      url-base: https://github.com/Mikan-jiru

  projects:
    - name: zmk
      remote: mikan-jiru
      repo-path: zmk-corne-xiao
      revision: revxlp-fix
      import: app/west.yml

  self:
    path: config
```
